## conf/layer.conf
```bitbake
# We have a conf and classes directory, add to BBPATH
BBPATH .= ":${LAYERDIR}"

# We have recipes-* directories, add to BBFILES
BBFILES += " \
	${LAYERDIR}/recipes-*/*/*.bb \
	${LAYERDIR}/recipes-*/*/*.bbappend \
	"

BBFILE_COLLECTIONS += "meta-vexpress-apps"
BBFILE_PATTERN_meta-vexpress-apps = "^${LAYERDIR}/"
LAYERDEPENDS_meta-vexpress-apps = " \
	meta-vexpress \
	core \
"

LAYERSERIES_COMPAT_meta-vexpress-apps = "kirkstone"
```
